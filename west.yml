## west.yml
```yaml
manifest:
  self:
    path: zephyr-honeygui

  remotes:
    - name: wanghao-realmcu
      url-base: https://github.com/wanghao-realmcu
    - name: display
      url-base: ssh://cn4soc.rtkbf.com:29418

  projects:
    - name: zephyr
      remote: wanghao-realmcu
      revision: realtek-main-v3.5.0
      import:
        name-allowlist:
          - cmsis
          - hal_realtek
          - tinycrypt
          - mbedtls
    - name: honeygui
      remote: display
      repo-path: HoneyGUI
      path: modules/display/honeygui
    - name: lvgl
      remote: wanghao-realmcu
      repo-path: lvgl
      path: modules/display/lvgl
      revision: 2b498e6f36d6b82ae1da12c8b7742e318624ecf5
    - name: wearable
      remote: display
      repo-path: Wearable
      path: modules/display/wearable
    - name: rtk-display-driver
      remote: display
      repo-path: HoneyRepo/driver/display
      path: modules/display/rtk-driver
```
